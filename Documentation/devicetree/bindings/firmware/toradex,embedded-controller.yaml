## Documentation/devicetree/bindings/firmware/toradex,embedded-controller.yaml
```yaml
# SPDX-License-Identifier: (GPL-2.0 OR BSD-2-Clause)
%YAML 1.2
---
$id: http://devicetree.org/schemas/firmware/toradex,embedded-controller.yaml#
$schema: http://devicetree.org/meta-schemas/core.yaml#

title: Toradex Embedded Controller

maintainers:
  - Emanuele Ghidoli <emanuele.ghidoli@toradex.com>
  - Francesco Dolcini <francesco.dolcini@toradex.com>

description:
  The Toradex Embedded Controller acts as a system controller which provides
  system power off and restart.

properties:
  compatible:
    items:
      - enum:
          - toradex,smarc-imx95-ec
          - toradex,smarc-imx8mp-ec
      - const: toradex,embedded-controller

  reg:
    maxItems: 1

required:
  - compatible
  - reg

additionalProperties: false

examples:
  - |
    i2c {
        #address-cells = <1>;
        #size-cells = <0>;

        embedded-controller@28 {
            compatible = "toradex,smarc-imx95-ec", "toradex,embedded-controller";
            reg = <0x28>;
        };
    };
```

## drivers/platform/toradex/Kconfig
```kconfig
menuconfig TORADEX_PLATFORMS
	bool "Platform support for Toradex hardware"
	help
	  Say Y here to be able to choose driver support for Toradex
	  devices. This option alone does not add any kernel code.

if TORADEX_PLATFORMS
config TORADEX_EC
	tristate "Toradex Embedded Controller driver"
	depends on I2C
	select REGMAP_I2C
	help
	  Say Y here to add support for the features implemented by the
	  Embedded Controller on the Toradex Modules.
	  To compile this driver as a module, choose M here; the module will be
	  called toradex-ec.

endif # TORADEX_PLATFORMS
```
